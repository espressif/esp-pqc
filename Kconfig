## examples/esp_hybrid_tls/main/Kconfig.projbuild
```kconfig
# SPDX-FileCopyrightText: 2025-2026 Espressif Systems (Shanghai) CO LTD
# SPDX-License-Identifier: Apache-2.0
# The crypto primitives themselves (X25519MLKEM768, ML-DSA-65) are Kconfig
# symbols owned by the esp-pqc component:
#   Component config -> Post-Quantum Cryptography (esp-pqc) -> mbedTLS -> Hybrid PQC TLS
#   Component config -> Post-Quantum Cryptography (esp-pqc) -> liboqs
# Do not redeclare them here (duplicate Kconfig breaks CMake). The profile
# choice below selects which CA and port the example uses, and main/CMakeLists.txt
# checks that the esp-pqc symbols agree with it, failing the build if they do not.

menu "Hybrid PQC TLS Example"

choice EXAMPLE_TLS_PROFILE
    prompt "TLS crypto profile"
    default EXAMPLE_TLS_PROFILE_FULL_PQC
    help
        Which combination of key exchange and certificate signature the example
        expects to negotiate. This picks the trust anchor that gets embedded and
        the TCP port to connect to, and it is cross-checked against the esp-pqc
        crypto options at build time.

        Each profile pairs with one scripts/run_server.sh mode.

    config EXAMPLE_TLS_PROFILE_CLASSICAL
        bool "Classical: X25519 + ECDSA-P256 (no PQC)"
        help
            Plain TLS 1.3 with no post-quantum algorithms, for footprint and
            handshake-time comparison against the PQC profiles.

            Embeds certs/ecdsa/test_ca.crt, connects on port 8443.
            Server: ./scripts/run_server.sh ecdsa

            Requires CONFIG_LIBOQS_ENABLED=n, which also drops both PQC TLS
            options and keeps liboqs out of the binary so the footprint number
            is meaningful.

    config EXAMPLE_TLS_PROFILE_HYBRID_KEM
        bool "Hybrid KEM: X25519MLKEM768 + ECDSA-P256"
        help
            Post-quantum key exchange with a classical certificate. This is the
            profile large deployments ship today: the hybrid KEM removes the
            harvest-now-decrypt-later risk, while certificates stay classical
            because the public PKI has not migrated to ML-DSA yet.

            Embeds certs/ecdsa/test_ca.crt, connects on port 8445.
            Server: ./scripts/run_server.sh hybrid-kem

            Requires X25519MLKEM768=y and MLDSA65=n. Note that with ML-DSA
            support compiled out, mbedTLS can no longer parse an ML-DSA
            certificate at all, so the ECDSA trust anchor is mandatory here.

    config EXAMPLE_TLS_PROFILE_FULL_PQC
        bool "Full PQC: X25519MLKEM768 + ML-DSA-65"
        help
            Post-quantum key exchange and a post-quantum certificate chain.

            Embeds certs/mldsa65/test_ca.crt, connects on port 8444.
            Server: ./scripts/run_server.sh mldsa65

            Requires X25519MLKEM768=y and MLDSA65=y.

endchoice

    config EXAMPLE_HTTP_DOWNLOAD
        bool "Download a test file over the TLS session and check its SHA-256"
        default n
        help
            After the handshake, request /tls_testfile.bin, store the response
            body in LittleFS and print its SHA-256, so the run also proves the
            record layer moved a known payload intact.

            This needs a server that actually serves files. Start the matching
            profile mode with the download argument:
              ./scripts/run_server.sh ecdsa download
              ./scripts/run_server.sh hybrid-kem download
              ./scripts/run_server.sh mldsa65 download

            When disabled (default), the example still sends the GET and reads
            the response, but discards the body instead of storing and hashing
            it. That is the right setting against a plain run_server.sh mode,
            which uses `s_server -www`: that option ignores the requested path
            and returns a generated status page whose contents differ per
            connection, so hashing it is meaningless.

    config EXAMPLE_DOWNLOAD_EXPECTED_SHA256
        string "Expected SHA-256 of the downloaded file (hex, empty to skip)"
        depends on EXAMPLE_HTTP_DOWNLOAD
        default "27783e87963a4efb6829b531c9ba57b44f45797f6770bd637fbf0d807cbdbae0"
        help
            Compared against the SHA-256 of the stored file, turning the
            download into a pass/fail check. The default is the digest of the
            100 KB files/tls_testfile.bin produced by the generator command in
            the README, so it holds for any freshly generated copy.

            Leave empty to only log the digest.

    config EXAMPLE_USE_TEST_CERTS
        bool "Use bundled test certificate (skip hostname/IP verification)"
        depends on EXAMPLE_TLS_PROFILE_FULL_PQC
        default n
        help
            Use the pre-generated ML-DSA-65 test certificate in certs/test/ and
            SKIP the server hostname (CN/SAN) check, so the example connects to
            the test server at ANY IP without regenerating certificates. The
            server certificate chain is still validated against the bundled test
            CA (certs/test/ca.crt), only the identity/IP match is skipped.

            This is for quick local testing only and is NOT secure: a valid cert
            from the test CA is accepted regardless of which host presents it.
            Do NOT enable it in production.

            When disabled (default), the example enforces full hostname
            verification against WEB_SERVER and you must regenerate
            certs/mldsa65/ for your server's IP (see README, "Regenerating the
            ML-DSA-65 certificates"). Run the matching test server with:
              ./scripts/run_server.sh test

            Only available in the full PQC profile, because the bundled test
            certificate is ML-DSA-65 signed.

endmenu
```

## examples/pqc_boot_verify/bootloader_components/esp_image_verify/Kconfig
```kconfig
# SPDX-FileCopyrightText: 2025-2026 Espressif Systems (Shanghai) CO LTD
# SPDX-License-Identifier: Apache-2.0
menu "PQC Secure Boot"

    config PQC_SECURE_BOOT_ENABLED
        bool "Enable PQC (ML-DSA-65) signature verification in bootloader"
        default y
        depends on SECURE_BOOT_V2_ENABLED && !SECURE_SIGNED_APPS_ECDSA_SCHEME
        help
            When enabled, the bootloader verifies the ML-DSA-65 PQC signature
            block (located immediately after the 4 KB RSA/ECDSA V2 signature block
            in flash) BEFORE performing RSA or ECDSA V2 Secure Boot V2 verification.
            Both checks must pass for the image to be loaded.

            Supported scheme: RSA-PSS 3072-bit (ESP32-C3/C5/C6).
            Not compatible with legacy ECDSA V1 scheme (SECURE_SIGNED_APPS_ECDSA_SCHEME).

            When disabled, only the standard RSA/ECDSA V2 Secure Boot V2 verification
            is performed — identical to unmodified ESP-IDF behaviour.

    choice PQC_MEMORY_STRATEGY
        prompt "PQC memory management strategy"
        depends on PQC_SECURE_BOOT_ENABLED
        default PQC_MEM_TLSF
        help
            Choose how ML-DSA-65 internal buffers are allocated during
            signature verification in the bootloader.

        config PQC_MEM_STACK
            bool "Stack (buffers on dedicated 80KB PQC stack)"
            help
                All ML-DSA-65 intermediate buffers are stack-allocated on
                the dedicated 80KB PQC stack reserved permanently in
                bootloader dram_seg. Simple, zero fragmentation, but costs
                ~80KB of app SRAM permanently.

        config PQC_MEM_TLSF
            bool "TLSF Heap (temporary app SRAM region)"
            help
                ML-DSA-65 buffers are dynamically allocated from a TLSF pool
                placed at a fixed address in the bottom of the app's SRAM
                (0x40800000). The bootloader borrows this region during
                verification, zeroes it afterwards, and the app reclaims it
                as heap — saving ~80KB of SRAM for the application.
                PQC call-frame stack is reduced to 8KB (call frames only).

    endchoice

    config PQC_TLSF_POOL_SIZE_KB
        int "TLSF pool size in KB"
        depends on PQC_MEM_TLSF
        default 48
        range 32 128
        help
            Size of the TLSF pool placed at PQC_TEMP_REGION_ADDR in app SRAM.
            ML-DSA-65 verify needs ~35KB peak. 48KB provides ~13KB headroom.

    config PQC_CALL_STACK_SIZE_KB
        int "PQC call-frame stack size in KB"
        depends on PQC_MEM_TLSF
        default 8
        range 4 16
        help
            Size of the PQC call-frame stack placed immediately after the
            TLSF pool in the temporary region. 8KB provides >4x headroom
            over the measured ~1.6KB maximum call depth.

    config PQC_MLD_REDUCE_RAM
        bool "Enable ML-DSA REDUCE_RAM optimizations"
        depends on PQC_SECURE_BOOT_ENABLED
        default y
        help
            When enabled, ML-DSA-65 uses row-buffer matrix multiplication
            and serial FIPS-202 hashing, reducing peak RAM from ~30KB to ~5KB
            at the cost of slower verification.

            Disable this to use the full-speed implementation and measure
            the actual RAM difference.

    config PQC_DEBUG_VERBOSE
        bool "Enable verbose PQC debug prints"
        depends on PQC_SECURE_BOOT_ENABLED
        default n
        help
            When enabled, prints detailed debug information during PQC
            verification: TLSF heap pointers and allocation sizes, PQC
            stack region addresses, PQC block header fields, and
            step-by-step verification progress.

            Useful for performance profiling and debugging memory issues.
            Disable for production builds to reduce boot time and log noise.

endmenu
```

## test_apps/liboqs_test/main/Kconfig.projbuild
```kconfig
# SPDX-FileCopyrightText: 2025-2026 Espressif Systems (Shanghai) CO LTD
# SPDX-License-Identifier: Apache-2.0
menu "esp-liboqs test app"

    config LIBOQS_TEST_TASK_STACK_SIZE
        int "Unity test task stack size (bytes)"
        default 24576
        help
            Stack for the FreeRTOS task that runs the Unity menu and test cases.
            With heap-backed ML-DSA/ML-KEM temporaries a few KB suffices; the
            stack_only build variant raises this to ~110 KB because ML-DSA-65
            then keeps ~56 KB of scratch on the stack.

    config LIBOQS_TEST_RUN_ALL_ON_BOOT
        bool "Run all Unity test cases automatically on boot"
        default n
        help
            When y, app_main runs every registered Unity test case once, then
            prints a completion marker — no interactive serial menu. This is the
            mode CI uses under esp-emu (ci/emu_run.py is read-only and cannot
            drive the menu). When n (default), the app presents the usual
            interactive unity_run_menu() for `idf.py monitor` and for
            pytest-embedded's run_all_single_board_cases().

endmenu
```
